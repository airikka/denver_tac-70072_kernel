## board/Kconfig
```kconfig
config CPU1
bool "config cpu 1.2G"
default n

config Q8
bool "config Q8 TP"
default n

config 86V
bool "config 86v Tp"
default y
```

## drivers/net/wireless/compat-wireless-3.0.9-1_TR/drivers/net/wireless/ath/Kconfig
```kconfig
menuconfig ATH_COMMON
	tristate "Atheros Wireless Cards"
	depends on CFG80211
	---help---
	  This will enable the support for the Atheros wireless drivers.
	  ath5k, ath9k, ath9k_htc and ar9170 drivers share some common code, this option
	  enables the common ath.ko module which shares common helpers.

	  For more information and documentation on this module you can visit:

	  http://wireless.kernel.org/en/users/Drivers/ath

	  For information on all Atheros wireless drivers visit:

	  http://wireless.kernel.org/en/users/Drivers/Atheros

if ATH_COMMON

config ATH_DEBUG
	bool "Atheros wireless debugging"
	---help---
	  Say Y, if you want to debug atheros wireless drivers.
	  Right now only ath9k makes use of this.

source "drivers/net/wireless/ath/ath5k/Kconfig"
source "drivers/net/wireless/ath/ath9k/Kconfig"
source "drivers/net/wireless/ath/carl9170/Kconfig"

config ATH9K_HTC_ANDROID
       bool "Atheros ath9k_htc android patch"
       depends on ATH9K_HTC
       ---help---
         Say Y, if you run ath9k_htc on android devices.

config AR9271_EEPROM_FILE
       bool "use bin file instead of EEPROM for Atheros ar9271"
       depends on ATH9K_HTC
       ---help---
         Say Y, if you use bin file instead of EEPROM.

endif
```
